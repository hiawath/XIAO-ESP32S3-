## XIAO-ESP32S3-Sense/main/Kconfig.projbuild
```kconfig
menu "카메라 앱 설정"

    config WIFI_SSID
        string "Wi-Fi SSID"
        default "myssid"
        help
            연결할 Wi-Fi 공유기 이름(SSID)을 입력하세요.

    config WIFI_PASSWORD
        string "Wi-Fi Password"
        default "mypassword"
        help
            Wi-Fi 비밀번호를 입력하세요.

endmenu
```

## sdkconfig.defaults
```kconfig
# ESP32-S3 타겟 설정
CONFIG_IDF_TARGET="esp32s3"

# PSRAM 활성화 (OV2640 프레임 버퍼 필수)
CONFIG_ESP32S3_SPIRAM_SUPPORT=y
CONFIG_SPIRAM_MODE_OCT=y
CONFIG_SPIRAM_SPEED_80M=y

# Flash 설정
CONFIG_ESPTOOLPY_FLASHSIZE_4MB=y
CONFIG_PARTITION_TABLE_SINGLE_APP=y

# 카메라 프레임 버퍼 → PSRAM
CONFIG_CAMERA_FB_IN_PSRAM=y

# HTTP 서버 스택 크기
CONFIG_HTTPD_MAX_REQ_HDR_LEN=1024
CONFIG_HTTPD_MAX_URI_LEN=512

# Wi-Fi 설정
CONFIG_ESP_WIFI_SOFTAP_SUPPORT=n

# 로그 레벨
CONFIG_LOG_DEFAULT_LEVEL_INFO=y

# FreeRTOS tick rate
CONFIG_FREERTOS_HZ=1000
```
